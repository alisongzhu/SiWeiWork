## CMakeLists.txt
```
cmake_minimum_required(VERSION 3.8.2)
# Re-direct the directory where the 'boards' directory is found from
# $ZEPHYR_BASE to this directory.
set(BOARD_ROOT ${CMAKE_CURRENT_LIST_DIR}/../)

# This sample is only compatible with nrf52840_pca10065 because it has
# re-directed the 'boards' directory to a directory that only contains
# this board.
set(BOARD itu_fx)

include($ENV{ZEPHYR_BASE}/cmake/app/boilerplate.cmake NO_POLICY_SCOPE)
project(itu-fx)

#FILE(GLOB app_sources src/*.c)
#target_sources(app PRIVATE ${app_sources})

target_sources(app PRIVATE src/main.c)
#target_include_directories(app PRIVATE $ENV{ZEPHYR_BASE}/subsys/fs/nvs)
```

## prj.conf
```kconfig
# global logging switch
CONFIG_LOG=y

# Ethernet is needed 
CONFIG_NETWORKING=y
CONFIG_NET_L2_ETHERNET=y

CONFIG_ETH_STM32_HAL=y
CONFIG_ETH_STM32_HAL_MII=y
CONFIG_ETH_STM32_HAL_PHY_ADDRESS=0

CONFIG_NET_IPV6=n
CONFIG_NET_IPV4=y
CONFIG_NET_TCP=y

CONFIG_NET_CONFIG_SETTINGS=y
CONFIG_NET_CONFIG_MY_IPV4_ADDR="192.168.123.123"

# how many network connections are supported
CONFIG_NET_MAX_CONN=6
CONFIG_NET_MAX_CONTEXTS=10

#CONFIG_NET_PKT_RX_COUNT=14
#CONFIG_NET_PKT_TX_COUNT=14
#CONFIG_NET_BUF_TX_COUNT=36
#CONFIG_NET_BUF_RX_COUNT=36

CONFIG_NET_SHELL=y
CONFIG_KERNEL_SHELL=y
CONFIG_DEVICE_SHELL=y
#CONFIG_SHELL_BACKEND_TELNET=y

CONFIG_NVS=y
CONFIG_NVS_LOG_LEVEL_DBG=y

CONFIG_REBOOT=y

CONFIG_PRINTK=y

CONFIG_BUILD_OUTPUT_HEX=y

# WARNING: when __ASSERT() statements are globally ENABLED,
# the kernel will run more slowly and use more memory.cho
# CONFIG_ASSERT=y
# CONFIG_FORCE_NO_ASSERT=y

# all printf, fprintf to stdout go to console
CONFIG_STDOUT_CONSOLE=y
CONFIG_EARLY_CONSOLE=y
```

## src/main.c
```c
/*
 * Copyright (c) 2012-2014 Wind River Systems, Inc.
 *
 * SPDX-License-Identifier: Apache-2.0
 */

#include <zephyr.h>
#include <misc/printk.h>

#include <device.h>
#include <string.h>
// #include <nvs/nvs.h>


#define NVS_SECTOR_SIZE FLASH_ERASE_BLOCK_SIZE /* Multiple of FLASH_PAGE_SIZE */
#define NVS_SECTOR_COUNT 4 /* At least 2 sectors */
#define NVS_STORAGE_OFFSET FLASH_AREA_STORAGE_OFFSET /* Start address of the
                                                      * filesystem in flash
                                                      */
void main(void)
{
	printk("Hello World! %s\n", CONFIG_ARCH);
}
```
