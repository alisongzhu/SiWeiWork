## CMakeLists.txt
```
cmake_minimum_required(VERSION 3.8.2)
# Re-direct the directory where the 'boards' directory is found from
# $ZEPHYR_BASE to this directory.
set(BOARD_ROOT ${CMAKE_CURRENT_LIST_DIR}/../)

# This sample is only compatible with nrf52840_pca10065 because it has
# re-directed the 'boards' directory to a directory that only contains
# this board.
set(BOARD syslight_gw_stm32)

include($ENV{ZEPHYR_BASE}/cmake/app/boilerplate.cmake NO_POLICY_SCOPE)
project(NONE)

#FILE(GLOB app_sources src/*.c)
#target_sources(app PRIVATE ${app_sources})

target_sources(app PRIVATE src/main.c)
#target_include_directories(app PRIVATE $ENV{ZEPHYR_BASE}/subsys/fs/nvs)
```

## prj.conf
```kconfig
# nothing here

CONFIG_FLASH=y

CONFIG_NVS=y
#CONFIG_LOG=y
CONFIG_NVS_LOG_LEVEL_DBG=y
CONFIG_REBOOT=y

# move below to <boards>_defconfig in the future
CONFIG_UART_2=y	
CONFIG_UART_3=y

CONFIG_SPI=y
CONFIG_SPI_1=y
# CONFIG_SPI_STM32=y

CONFIG_I2C=y
CONFIG_I2C_1=y
# CONFIG_I2C_STM32_V1=y

CONFIG_GPIO=y

# CONFIG_WATCHDOG=y

CONFIG_PRINTK=y

CONFIG_BUILD_OUTPUT_HEX=y

# WARNING: when __ASSERT() statements are globally ENABLED,
# the kernel will run more slowly and use more memory.cho
# CONFIG_ASSERT=y
# CONFIG_FORCE_NO_ASSERT=y

# all printf, fprintf to stdout go to console
CONFIG_STDOUT_CONSOLE=y
CONFIG_EARLY_CONSOLE=y
CONFIG_LOG=y


CONFIG_SYS_CLOCK_TICKS_PER_SEC=1000
```

## src/main.c
```c
/*
 * Copyright (c) 2012-2014 Wind River Systems, Inc.
 *
 * SPDX-License-Identifier: Apache-2.0
 */

#include <zephyr.h>
#include <misc/printk.h>

#include <device.h>
#include <string.h>
#include <nvs/nvs.h>


#define NVS_SECTOR_SIZE FLASH_ERASE_BLOCK_SIZE /* Multiple of FLASH_PAGE_SIZE */
#define NVS_SECTOR_COUNT 4 /* At least 2 sectors */
#define NVS_STORAGE_OFFSET FLASH_AREA_STORAGE_OFFSET /* Start address of the
                                                      * filesystem in flash
                                                      */
void main(void)
{
	printk("Hello World! %s\n", CONFIG_ARCH);
}
```
