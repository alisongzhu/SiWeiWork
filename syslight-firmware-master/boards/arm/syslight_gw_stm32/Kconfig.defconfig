## syslight-firmware-master/boards/arm/syslight_gw_stm32/Kconfig.defconfig
```kconfig
# Kconfig - STM32 Minimum Development Board Configuration
#
# Copyright (c) 2017, embedjournal.com
#
# SPDX-License-Identifier: Apache-2.0
#

if BOARD_SYSLIGHT_GW_STM32

config BOARD
	default "syslight_gw_stm32"

if UART_CONSOLE

config UART_1
	default y

endif # UART_CONSOLE
	
endif # BOARD_SYSLIGHT_GW_STM32
```

## zephyrproject/boards/arm/itu_fx/Kconfig.board
```kconfig
# Kconfig - iTU FX Board Configuration

config BOARD_ITU_FX
	bool "Sysware iTU FX Board"
	depends on SOC_STM32F407XG
```

## zephyrproject/boards/arm/itu_fx/Kconfig.defconfig
```kconfig
# Kconfig - STM32 Minimum Development Board Configuration
#
# Copyright (c) 2018, sysware Co. Ltd.
#
# SPDX-License-Identifier: Apache-2.0
#

if BOARD_ITU_FX

config BOARD
	default "itu_fx"

if UART_CONSOLE

config UART_1
	default y

endif # UART_CONSOLE
	
if SERIAL

config UART_2
	default y

endif #SERIAL

if GPIO
config GPIO_STM32_PORTG
	default n
config GPIO_STM32_PORTI
	default n
endif #GPIO

endif # BOARD_ITU_FX
```

## zephyrproject/boards/arm/itu_fx/itu_fx_defconfig
```kconfig
# Zephyr Kernel Configuration
CONFIG_ARM=y

# Platform Configuration
CONFIG_SOC_SERIES_STM32F4X=y
CONFIG_SOC_STM32F407XG=y
CONFIG_BOARD_ITU_FX=y

# General Kernel Options
CONFIG_CORTEX_M_SYSTICK=y

# 168MHz system clock
CONFIG_SYS_CLOCK_HW_CYCLES_PER_SEC=168000000
CONFIG_SYS_CLOCK_TICKS_PER_SEC=1000

# Enable MPU
#CONFIG_ARM_MPU=y

# flash hardware support
CONFIG_FLASH=y

# Serial Drivers
CONFIG_SERIAL=y
CONFIG_UART_INTERRUPT_DRIVEN=y

# enable console
CONFIG_CONSOLE=y
CONFIG_UART_CONSOLE=y

# enable pinmux
CONFIG_PINMUX=y

# enable GPIO
CONFIG_GPIO=y

# enable SPI
#CONFIG_SPI=y

# enable I2C
#CONFIG_I2C=y 

#enable WATCHDOG
#CONFIG_WATCHDOG=y 

# clock configuration
CONFIG_CLOCK_CONTROL=y

# enable RTC
#CONFIG_RTC=y
#CONFIG_RTC_STM32_CLOCK_LSE=y

# enbale DMA
#CONFIG_DMA=y

# enable CAN
#CONFIG_CAN=y

# enable HWIFO
CONFIG_HWINFO=y

# Clock configuration for Cube Clock control driver
CONFIG_CLOCK_STM32_HSE_CLOCK=8000000
CONFIG_CLOCK_STM32_SYSCLK_SRC_PLL=y

# Use HSE as PLL input
CONFIG_CLOCK_STM32_PLL_SRC_HSE=y
# produce 168MHz clock at PLL output
CONFIG_CLOCK_STM32_PLL_M_DIVISOR=8
CONFIG_CLOCK_STM32_PLL_N_MULTIPLIER=336
CONFIG_CLOCK_STM32_PLL_P_DIVISOR=2
CONFIG_CLOCK_STM32_PLL_Q_DIVISOR=7

# APB clock configuration
CONFIG_CLOCK_STM32_AHB_PRESCALER=1
CONFIG_CLOCK_STM32_APB1_PRESCALER=4
CONFIG_CLOCK_STM32_APB2_PRESCALER=2
```

## zephyrproject/boards/arm/syslight_gw_stm32/Kconfig.board
```kconfig
# Kconfig - Syslight Gateway STM32 Board Configuration

config BOARD_SYSLIGHT_GW_STM32
	bool "Syslight Gateway STM32 Board"
	depends on SOC_STM32F103X8
```

## zephyrproject/boards/arm/syslight_gw_stm32/syslight_gw_stm32_defconfig
```kconfig
# Zephyr Kernel Configuration
CONFIG_ARM=y
CONFIG_SOC_SERIES_STM32F1X=y

# Platform Configuration
CONFIG_SOC_STM32F103X8=y
CONFIG_BOARD_SYSLIGHT_GW_STM32=y

# General Kernel Options
CONFIG_CORTEX_M_SYSTICK=y

# 72MHz system clock
CONFIG_SYS_CLOCK_HW_CYCLES_PER_SEC=72000000

# Serial Drivers
CONFIG_SERIAL=y
CONFIG_UART_INTERRUPT_DRIVEN=y

# enable console
CONFIG_CONSOLE=y
CONFIG_UART_CONSOLE=y

# enable pinmux
CONFIG_PINMUX=y

# enable GPIO
#CONFIG_GPIO=y

# enable SPI
#CONFIG_SPI=y

# enable I2C
#CONFIG_I2C=y 

#enable WATCHDOG
#CONFIG_WATCHDOG=y 

# RCC configuration
CONFIG_CLOCK_CONTROL=y
# Clock configuration for Cube Clock control driver
CONFIG_CLOCK_STM32_HSE_CLOCK=8000000
CONFIG_CLOCK_STM32_SYSCLK_SRC_PLL=y

# Use HSE as PLL input
CONFIG_CLOCK_STM32_PLL_SRC_HSE=y
# Produce 72MHz clock at PLL output
CONFIG_CLOCK_STM32_PLL_XTPRE=n
CONFIG_CLOCK_STM32_PLL_MULTIPLIER=9
CONFIG_CLOCK_STM32_AHB_PRESCALER=1

# APB1 clock must not exceed 36MHz limit
CONFIG_CLOCK_STM32_APB1_PRESCALER=2
CONFIG_CLOCK_STM32_APB2_PRESCALER=1
```
